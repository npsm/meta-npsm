## conf/layer.conf
```bitbake
BBPATH .= ":${LAYERDIR}"
BBFILES += "${LAYERDIR}/recipes*/*/*.bb ${LAYERDIR}/recipes*/*/*.bbappend"
BBFILE_COLLECTIONS += "meta-npsm"
BBFILE_PATTERN_meta-npsm := "^${LAYERDIR}/"
BBFILE_PRIORITY_meta-npsm = "91"
```
